[ ] window MainWin CUsersLaptopDesktopLaba5NpoTestNotepad
[+] window MainWin CUsersLaptopDesktopLaba5NpoTes
	[ ] locator "/MainWin[@caption='*C:\Users\laptop\Desktop\laba 5 npo\test - Notepad++']"
	[+] Control Scintilla
		[ ] locator "@windowClassName='Scintilla'"
	[+] Control La
		[ ] locator "la"
	[+] Control Laba5Test1
		[ ] locator "laba 5 test 1"
	[+] Control Qwertyuiop1234567890
		[ ] locator "qwertyuiop1234567890"
	[+] Control Qwertyuiop1234567890qwertyuiop
		[ ] locator "qwertyuiop1234567890qwertyuiop1234567890"
	[+] PushToolItem PushToolItem
		[ ] locator "[9]"
	[-] PushToolItem PushToolItem10
		[ ] locator "[10]"
