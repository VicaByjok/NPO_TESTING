[+] window MainWin FastStoneCapture
	[ ] locator "/MainWin[@caption='FastStone Capture']"
	[+] Control FastStoneCapture
		[ ] locator "FastStone Capture"
	[+] Control TPanel
		[ ] locator "//Control[@caption='FastStone Capture']//Control[@windowClassName='TPanel']"
	[+] Control TPanel2
		[ ] locator "//Control[@caption='FastStone Capture']//Control[@windowClassName='TPanel'][2]"
	[+] Control TTBDock
		[ ] locator "//Control[@caption='FastStone Capture']//Control[@windowClassName='TTBDock']"
	[+] Control TBXToolbar2
		[ ] locator "//Control[@caption='FastStone Capture']//Control[@caption='TBXToolbar2']"
	[+] Control ЭкраннаяЛинейка
		[ ] locator "Экранная линейка"
	[+] Control TForm
		[ ] locator "@windowClassName='TForm'"
	[+] Control TRectangleCapture
		[ ] locator "@windowClassName='TRectangleCapture'"
	[+] Control ЭкраннаяЛупа
		[ ] locator "Экранная лупа"
	[+] Control TPanel1
		[ ] locator "//Control[@caption='Экранная лупа']//Control[@windowClassName='TPanel']"
	[-] Control TTBXPopupWindow
		[ ] locator "@windowClassName='TTBXPopupWindow'"
	[+] DialogBox Открыть
		[ ] locator "Открыть"
		[+] ListViewEx ListView
			[ ] locator "//ListViewEx"
		[+] PushButton Открыть
			[ ] locator "Открыть"
		[-] PushToolItem РабочийСтол
			[ ] locator "Рабочий стол"
	[-] Control TCaptureWindows
		[ ] locator "@windowClassName='TCaptureWindows'"
[-] window MainWin РедакторFastStone
	[ ] locator "/MainWin[@caption='Редактор FastStone ']"
	[-] Control TPanel
		[ ] locator "@windowClassName='TPanel'"
	[-] Control TimgFrame
		[ ] locator "@windowClassName='TimgFrame'"
	[-] Control TPanel2
		[ ] locator "[@windowClassName='TPanel'][2]"
	[-] Control TMyPageControl
		[ ] locator "@windowClassName='TMyPageControl'"
	[-] Control TTabSheet
		[ ] locator "@windowClassName='TTabSheet'"
	[-] Control TPanel3
		[ ] locator "[@windowClassName='TPanel'][3]"
	[-] Control TTBXStatusBar
		[ ] locator "@windowClassName='TTBXStatusBar'"
	[-] Control TTBDock
		[ ] locator "@windowClassName='TTBDock'"
	[-] Control TTBXToolbar
		[ ] locator "@windowClassName='TTBXToolbar'"
	[-] Control TBXToolbar1
		[ ] locator "TBXToolbar1"
[-] window MainWin Снимок1РедакторFastStone
	[ ] locator "/MainWin[@caption='Снимок 1 - Редактор FastStone ']"
	[+] Control TTBXToolbar
		[ ] locator "@windowClassName='TTBXToolbar'"
	[+] DialogBox СохранитьКак
		[ ] locator "Сохранить как"
		[+] ListViewEx ListView
			[ ] locator "//ListViewEx"
		[-] PushButton Сохранить
			[ ] locator "Сохранить"
[-] window MainWin CUsersLaptopDesktopLaba5NpoEva
	[ ] locator "/MainWin[@caption='C:\Users\laptop\Desktop\laba 5 npo\eva.bmp - Редактор FastStone ']"
	[-] Control TTBXToolbar
		[ ] locator "@windowClassName='TTBXToolbar'"
	[-] Control TImageEnView
		[ ] locator "@windowClassName='TImageEnView'"
	[+] DialogBox СохранитьКак
		[ ] locator "Сохранить как"
		[+] ListViewEx ListView
			[ ] locator "//ListViewEx"
		[-] PushButton Сохранить
			[ ] locator "Сохранить"
[-] window MainWin CUsersLaptopDesktopLaba5NpoHug
	[ ] locator "/MainWin[@caption='C:\Users\laptop\Desktop\laba 5 npo\hugoboss.jpg - Редактор FastStone ']"
	[-] Control TTBXToolbar
		[ ] locator "@windowClassName='TTBXToolbar'"
[-] window MainWin РисованиеFastStone
	[ ] locator "/MainWin[@caption='Рисование FastStone ']"
	[+] Control TImageEnVect
		[ ] locator "@windowClassName='TImageEnVect'"
	[+] Control TIETextControl
		[ ] locator "@windowClassName='TIETextControl'"
	[+] Control ОК
		[ ] locator "ОК"
	[+] DialogBox Открыть
		[ ] locator "Открыть"
		[+] ListViewEx ListView
			[ ] locator "//ListViewEx"
		[-] PushButton Открыть
			[ ] locator "Открыть"
[-] window MainWin CUsersLaptopDesktopLaba5NpoRbJ
	[ ] locator "/MainWin[@caption='C:\Users\laptop\Desktop\laba 5 npo\rb.jpg - Редактор FastStone ']"
	[-] Control TImageEnView
		[ ] locator "@windowClassName='TImageEnView'"
[-] window MainWin НовоеИзображение
	[ ] locator "/MainWin[@caption='Новое изображение']"
	[-] Control ОК
		[ ] locator "ОК"
[-] window MainWin CUsersLaptopDesktopLaba5NpoLab
	[ ] locator "/MainWin[@caption='C:\Users\laptop\Desktop\laba 5 npo\laba_5_npo_1\2020-11-13_134237.png - Редактор FastStone ']"
	[-] Control TTBXToolbar
		[ ] locator "@windowClassName='TTBXToolbar'"
[-] window MainWin CUsersLaptopDesktopLaba5NpoLab1
	[ ] locator "/MainWin[@caption='C:\Users\laptop\Desktop\laba 5 npo\laba_5_npo_1\2020-11-13_193038.png - Редактор FastStone ']"
	[-] Control TTBXToolbar
		[ ] locator "@windowClassName='TTBXToolbar'"
[-] window MainWin CUsersLaptopDesktopLaba5NpoLab2
	[ ] locator "/MainWin[@caption='C:\Users\laptop\Desktop\laba 5 npo\laba_5_npo_1\2020-11-14_091923.png - Редактор FastStone ']"
	[-] Control TTBXToolbar
		[ ] locator "@windowClassName='TTBXToolbar'"
[-] window MainWin CUsersLaptopDesktopLaba5NpoLab3
	[ ] locator "/MainWin[@caption='C:\Users\laptop\Desktop\laba 5 npo\laba_5_npo_1\2020-11-14_093000.png - Редактор FastStone ']"
	[-] Control TTBXToolbar
		[ ] locator "@windowClassName='TTBXToolbar'"
